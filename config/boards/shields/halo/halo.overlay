/ {
    chosen {
        zmk,kscan = &kscan0;
    };

    kscan0: kscan_direct {
        compatible = "zmk,kscan-gpio-direct";
        label = "KSCAN_DIRECT";
        input-gpios
            = <&gpio0 6  (GPIO_ACTIVE_LOW | GPIO_PULL_UP)> // Pin 1  ➔ Key 1 (Esc)
            , <&gpio0 8  (GPIO_ACTIVE_LOW | GPIO_PULL_UP)> // Pin 2  ➔ Key 2 (Shift)
            , <&gpio0 17 (GPIO_ACTIVE_LOW | GPIO_PULL_UP)> // Pin 7  ➔ Key 3 (Ctrl)
            , <&gpio0 20 (GPIO_ACTIVE_LOW | GPIO_PULL_UP)> // Pin 8  ➔ Key 4 (Macro: a)
            , <&gpio0 22 (GPIO_ACTIVE_LOW | GPIO_PULL_UP)> // Pin 9  ➔ Key 5 (Macro: d)
            , <&gpio0 24 (GPIO_ACTIVE_LOW | GPIO_PULL_UP)> // Pin 10 ➔ Key 6 (Macro: i)
            , <&gpio1 0  (GPIO_ACTIVE_LOW | GPIO_PULL_UP)> // Pin 11 ➔ Key 7 (Macro: Spare)
            , <&gpio1 4  (GPIO_ACTIVE_LOW | GPIO_PULL_UP)> // Pin 17 ➔ Key 8 (Thumb: Rotation Lock)
            , <&gpio1 6  (GPIO_ACTIVE_LOW | GPIO_PULL_UP)> // Pin 18 ➔ Key 9 (Thumb: View-Dance Switch)
            ;
    };
};
